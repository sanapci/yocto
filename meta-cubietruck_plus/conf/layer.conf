## meta-cubietruck_plus/conf/layer.conf
```bitbake
# We have a conf and classes directory, add to BBPATH
BBPATH .= ":${LAYERDIR}"

# We have recipes-* directories, add to BBFILES
BBFILES += " \
    ${LAYERDIR}/recipes-*/*/*.bb \
    ${LAYERDIR}/recipes-*/*/*.bbappend \
"

BBFILE_COLLECTIONS += "meta-cubietruck_plus"
BBFILE_PATTERN_meta-cubietruck_plus = "^${LAYERDIR}/"
BBFILE_PRIORITY_meta-cubietruck_plus = "15"

LAYERVERSION_meta-cubietruck_plus = "1"

# LAYERDEPENDS_meta-cubietruck_plus = "core meta-sunxi"
LAYERDEPENDS_meta-cubietruck_plus = "sunxi"

LAYERSERIES_COMPAT_meta-cubietruck_plus = "scarthgap"
```

## meta-cubietruck_plus/conf/machine/cubietruck-plus.conf
```bitbake
#@TYPE: Machine
#@NAME: cubietruck-plus
#@DESCRIPTION: Machine configuration for the cubietruck-plus, base on allwinner H8 CPU

require conf/machine/include/sun8i.inc
require conf/machine/include/hardware/ap6330.inc

KERNEL_DEVICETREE = "sun8i-a83t-cubietruck-plus.dtb"
UBOOT_MACHINE = "Cubietruck_plus_defconfig"

DEFAULTTUNE = "cortexa7hf-neon-vfpv4"
```
